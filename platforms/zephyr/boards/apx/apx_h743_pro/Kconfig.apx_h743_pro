## platforms/zephyr/boards/apx/apx_h743_pro/Kconfig.apx_h743_pro
```kconfig
# SPDX-License-Identifier: CC-BY-NC-4.0
# Copyright (c) 2026 Savita Pawar <savitapawar0402@gmail.com>
# Author: Savita Pawar (SVPR94)
# Created: 2026
# APX H743 Pro (STM32H743).

config BOARD_APX_H743_PRO
	select SOC_STM32H743XX
```

## platforms/zephyr/boards/apx/apx_h743_pro/board.yml
```yaml
board:
  name: apx_h743_pro
  full_name: APX H743 Pro
  vendor: apx
  socs:
    - name: stm32h743xx
```

## platforms/zephyr/boards/apx/apx_h743_v1/board.yml
```yaml
board:
  name: apx_h743_v1
  full_name: APX H743 v1
  vendor: apx
  socs:
    - name: stm32h743xx
```

## platforms/zephyr/boards/apx/custom_h7_fc/board.yml
```yaml
board:
  name: custom_h7_fc
  full_name: Custom H7 flight controller
  vendor: apx
  socs:
    - name: stm32h743xx
```

## platforms/zephyr/boards/cubepilot/cube_orange_plus/board.yml
```yaml
board:
  name: cube_orange_plus
  full_name: CubePilot Cube Orange+
  vendor: cubepilot
  socs:
    - name: stm32h757xx
```
