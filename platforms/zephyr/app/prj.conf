## CMakeLists.txt
```
# SPDX-License-Identifier: CC-BY-NC-4.0
# Copyright (c) 2026 Savita Pawar <savitapawar0402@gmail.com>
# Author: Savita Pawar (SVPR94)
# Created: 2026
cmake_minimum_required(VERSION 3.20.0)

# Out-of-tree boards (platforms/zephyr/boards/<vendor>/<board>)
list(APPEND BOARD_ROOT ${CMAKE_CURRENT_LIST_DIR}/..)

find_package(Zephyr REQUIRED HINTS $ENV{ZEPHYR_BASE})
project(apx_firmware LANGUAGES C CXX)

get_filename_component(APX_ROOT ${CMAKE_CURRENT_LIST_DIR}/../../.. ABSOLUTE)

# APX_PLATFORM_ZEPHYR selects the Zephyr kernel shims (kernel/src);
# APX_PLATFORM_STM32H7 marks a non-hosted build (no sockets/threads).
target_compile_definitions(app PRIVATE
    APX_PLATFORM_ZEPHYR
    APX_PLATFORM_STM32H7
    APX_BOARD_STM32H7
)

target_include_directories(app PRIVATE
    ${APX_ROOT}
    ${APX_ROOT}/kernel/include
    ${APX_ROOT}/hal/include
    ${APX_ROOT}/drivers
    ${APX_ROOT}/drivers/include
    ${APX_ROOT}/modules
    ${APX_ROOT}/modules/params
    ${APX_ROOT}/modules/gcs
    ${APX_ROOT}/modules/gcs/mavlink
    ${APX_ROOT}/modules/gcs/mavlink/common
    ${APX_ROOT}/modules/modes
    ${APX_ROOT}/modules/flight_control
    ${APX_ROOT}/modules/safety
    ${APX_ROOT}/modules/estimator
    ${APX_ROOT}/modules/estimator/altitude_estimator
)

set(APX_MODES
    navigation_cascade path_tracker scurve sprayer land_detector crash_detector stick_arm_detector
    mode_stabilize mode_althold mode_guided mode_poshold mode_loiter mode_brake mode_auto
    mode_rtl mode_land mode_agri_spray mode_agri_zigzag mode_manager
)
list(TRANSFORM APX_MODES PREPEND ${APX_ROOT}/modules/modes/)
list(TRANSFORM APX_MODES APPEND .cpp)

target_sources(app PRIVATE
    src/main.cpp
    ${APX_ROOT}/kernel/src/timer.cpp
    ${APX_ROOT}/kernel/src/mutex.cpp
    ${APX_ROOT}/modules/params/param_manager.cpp
    ${APX_ROOT}/modules/safety/fence.cpp
    ${APX_ROOT}/modules/gcs/mavlink_handler.cpp
    ${APX_ROOT}/modules/gcs/command_handler.cpp
    ${APX_ROOT}/modules/flight_control/rate_controller/pid_controller.cpp
    ${APX_ROOT}/modules/flight_control/rate_controller/rate_controller.cpp
    ${APX_ROOT}/modules/flight_control/attitude_controller/attitude_controller.cpp
    ${APX_ROOT}/modules/flight_control/position_controller/position_controller.cpp
    ${APX_ROOT}/modules/flight_control/mixer/motor_mixer.cpp
    ${APX_ROOT}/modules/estimator/altitude_estimator/altitude_estimator.cpp
    ${APX_MODES}
)

# MAVLink's generated headers take the address of packed members.
target_compile_options(app PRIVATE $<$<COMPILE_LANGUAGE:CXX>:-Wno-address-of-packed-member>)

# Bootloader package: .apj for upload through the board's stock
# bootloader (APX Flight Manager / GCS "custom firmware").
set(APX_APJ_BOARD_ID 1063) # CubeOrange+ board id
# (An ordinary target: Zephyr reads extra_post_build_commands inside
# find_package(), before this file could append to it.)
set(APX_APJ ${CMAKE_BINARY_DIR}/zephyr/apx_cube_orange_plus.apj)
add_custom_command(
    OUTPUT ${APX_APJ}
    COMMAND ${PYTHON_EXECUTABLE} ${APX_ROOT}/tools/make_apj.py
            --bin ${CMAKE_BINARY_DIR}/zephyr/zephyr.bin
            --board-id ${APX_APJ_BOARD_ID}
            --summary "APX ${BOARD}"
            --flash-total 917504
            --out ${APX_APJ}
    DEPENDS zephyr_final ${CMAKE_BINARY_DIR}/zephyr/zephyr.bin ${APX_ROOT}/tools/make_apj.py
    COMMENT "APX: packaging .apj for the bootloader"
    VERBATIM
)
add_custom_target(apx_apj ALL DEPENDS ${APX_APJ})
```

## Kconfig.sysbuild
```
# SPDX-License-Identifier: CC-BY-NC-4.0
# Copyright (c) 2026 Savita Pawar <savitapawar0402@gmail.com>
# Author: Savita Pawar (SVPR94)
# Created: 2026
# Sysbuild options for the APX flight firmware (west build --sysbuild).

config APX_BOOTLOADER
	bool "Build the APX bootloader and a combined bootloader + firmware image"
	default y
	help
	  Builds platforms/zephyr/bootloader together with the firmware and
	  packages build/<dir>/firmware/: bootloader, firmware, .apj and the
	  combined image to flash once over SWD. Boards that keep a stock
	  bootloader can still build it; flashing it is optional.

source "share/sysbuild/Kconfig"
```

## prj.conf
```kconfig
# SPDX-License-Identifier: Apache-2.0
# APX hardware firmware - Zephyr configuration (bring-up milestone 1).

# C++17 with the full standard library (newlib, from the Arm GNU toolchain)
CONFIG_CPP=y
CONFIG_STD_CPP17=y
CONFIG_REQUIRES_FULL_LIBCPP=y
CONFIG_NEWLIB_LIBC=y

# Hard-float FPU, shared between threads
CONFIG_FPU=y
CONFIG_FPU_SHARING=y

CONFIG_MAIN_STACK_SIZE=16384

# Microsecond time for the control loop (64-bit SysTick cycle counter)
CONFIG_CORTEX_M_SYSTICK_64BIT_CYCLE_COUNTER=y

# MAVLink over USB CDC-ACM (device stack "next")
CONFIG_SERIAL=y
CONFIG_UART_INTERRUPT_DRIVEN=y
CONFIG_UART_LINE_CTRL=y
CONFIG_USB_DEVICE_STACK_NEXT=y
CONFIG_USBD_CDC_ACM_CLASS=y
CONFIG_CDC_ACM_SERIAL_INITIALIZE_AT_BOOT=y
CONFIG_CDC_ACM_SERIAL_MANUFACTURER_STRING="APX"
CONFIG_CDC_ACM_SERIAL_PRODUCT_STRING="APX Cube Orange+"

CONFIG_RING_BUFFER=y

# No debug console on this board: the USB port carries MAVLink.
CONFIG_CONSOLE=n
CONFIG_UART_CONSOLE=n
CONFIG_LOG=n
```

## boards/apx_h743_pro.conf
```kconfig
# SPDX-License-Identifier: CC-BY-NC-4.0
# Copyright (c) 2026 Savita Pawar <savitapawar0402@gmail.com>
# Author: Savita Pawar (SVPR94)
# Created: 2026
# GCS link: MAVLink over USB CDC-ACM (device stack "next"); the devicetree
# chooses it with apx,gcs-uart = &cdc_acm_uart0.
CONFIG_UART_LINE_CTRL=y
CONFIG_USB_DEVICE_STACK_NEXT=y
CONFIG_USBD_CDC_ACM_CLASS=y
CONFIG_CDC_ACM_SERIAL_INITIALIZE_AT_BOOT=y
CONFIG_CDC_ACM_SERIAL_MANUFACTURER_STRING="APX"
CONFIG_CDC_ACM_SERIAL_PRODUCT_STRING="APX H743 Pro"
```

## boards/ark_v6x.conf
```kconfig
# SPDX-License-Identifier: CC-BY-NC-4.0
# Copyright (c) 2026 Savita Pawar <savitapawar0402@gmail.com>
# Author: Savita Pawar (SVPR94)
# Created: 2026
# ARK V6X: GCS (MAVLink) link over USB CDC-ACM. Generated by tools/import_board.py from the board's hardware description; re-run it rather than editing.
CONFIG_UART_LINE_CTRL=y
CONFIG_USB_DEVICE_STACK_NEXT=y
CONFIG_USBD_CDC_ACM_CLASS=y
CONFIG_CDC_ACM_SERIAL_INITIALIZE_AT_BOOT=y
CONFIG_CDC_ACM_SERIAL_MANUFACTURER_STRING="APX"
CONFIG_CDC_ACM_SERIAL_PRODUCT_STRING="APX ARK V6X"
```

## boards/cuav_7_nano.conf
```kconfig
# SPDX-License-Identifier: CC-BY-NC-4.0
# Copyright (c) 2026 Savita Pawar <savitapawar0402@gmail.com>
# Author: Savita Pawar (SVPR94)
# Created: 2026
# CUAV 7-Nano: GCS (MAVLink) link over USB CDC-ACM. Generated by tools/import_board.py from the board's hardware description; re-run it rather than editing.
CONFIG_UART_LINE_CTRL=y
CONFIG_USB_DEVICE_STACK_NEXT=y
CONFIG_USBD_CDC_ACM_CLASS=y
CONFIG_CDC_ACM_SERIAL_INITIALIZE_AT_BOOT=y
CONFIG_CDC_ACM_SERIAL_MANUFACTURER_STRING="APX"
CONFIG_CDC_ACM_SERIAL_PRODUCT_STRING="APX CUAV 7-Nano"
```

## boards/cuav_nora.conf
```kconfig
# SPDX-License-Identifier: CC-BY-NC-4.0
# Copyright (c) 2026 Savita Pawar <savitapawar0402@gmail.com>
# Author: Savita Pawar (SVPR94)
# Created: 2026
# CUAV Nora: GCS (MAVLink) link over USB CDC-ACM. Generated by tools/import_board.py from the board's hardware description; re-run it rather than editing.
CONFIG_UART_LINE_CTRL=y
CONFIG_USB_DEVICE_STACK_NEXT=y
CONFIG_USBD_CDC_ACM_CLASS=y
CONFIG_CDC_ACM_SERIAL_INITIALIZE_AT_BOOT=y
CONFIG_CDC_ACM_SERIAL_MANUFACTURER_STRING="APX"
CONFIG_CDC_ACM_SERIAL_PRODUCT_STRING="APX CUAV Nora"
```

## boards/cuav_x7.conf
```kconfig
# SPDX-License-Identifier: CC-BY-NC-4.0
# Copyright (c) 2026 Savita Pawar <savitapawar0402@gmail.com>
# Author: Savita Pawar (SVPR94)
# Created: 2026
# CUAV X7 / X7 Pro: GCS (MAVLink) link over USB CDC-ACM. Generated by tools/import_board.py from the board's hardware description; re-run it rather than editing.
CONFIG_UART_LINE_CTRL=y
CONFIG_USB_DEVICE_STACK_NEXT=y
CONFIG_USBD_CDC_ACM_CLASS=y
CONFIG_CDC_ACM_SERIAL_INITIALIZE_AT_BOOT=y
CONFIG_CDC_ACM_SERIAL_MANUFACTURER_STRING="APX"
CONFIG_CDC_ACM_SERIAL_PRODUCT_STRING="APX CUAV X7 / X7 Pro"
```

## boards/cube_orange.conf
```kconfig
# SPDX-License-Identifier: CC-BY-NC-4.0
# Copyright (c) 2026 Savita Pawar <savitapawar0402@gmail.com>
# Author: Savita Pawar (SVPR94)
# Created: 2026
# CubePilot Cube Orange: GCS (MAVLink) link over USB CDC-ACM. Generated by tools/import_board.py from the board's hardware description; re-run it rather than editing.
CONFIG_UART_LINE_CTRL=y
CONFIG_USB_DEVICE_STACK_NEXT=y
CONFIG_USBD_CDC_ACM_CLASS=y
CONFIG_CDC_ACM_SERIAL_INITIALIZE_AT_BOOT=y
CONFIG_CDC_ACM_SERIAL_MANUFACTURER_STRING="APX"
CONFIG_CDC_ACM_SERIAL_PRODUCT_STRING="APX CubePilot Cube Orange"
# Board's USB ids, so ground stations recognise it
CONFIG_CDC_ACM_SERIAL_VID=0x2DAE
CONFIG_CDC_ACM_SERIAL_PID=0x1016
```

## src/main.cpp
```c
// SPDX-License-Identifier: CC-BY-NC-4.0
// Copyright (c) 2026 Savita Pawar <savitapawar0402@gmail.com>
// Author: Savita Pawar (SVPR94)
// Created: 2026
// connect. There are no sensor drivers and no motor outputs yet, and the
// GCS is told so: no sensors present, no attitude or position, battery
// unknown, and arming is refused.

#include <zephyr/device.h>
#include <zephyr/drivers/gpio.h>
#include <zephyr/drivers/uart.h>
#include <zephyr/kernel.h>
#include <zephyr/sys/ring_buffer.h>

#include "apx/kernel/timer.hpp"
#include "mavlink_handler.hpp"
#include "mode_manager.hpp"
#include "param_manager.hpp"

namespace {

constexpr uint32_t kLoopHz = 400;
constexpr uint32_t kLoopPeriodUs = 1000000 / kLoopHz;
constexpr uint32_t kNoticePeriodS = 60;

const gpio_dt_spec kLed = GPIO_DT_SPEC_GET(DT_ALIAS(led0), gpios);
const gpio_dt_spec kSensorsPower = GPIO_DT_SPEC_GET(DT_PATH(zephyr_user), sensors_power_gpios);
const gpio_dt_spec kPeriph5vPower = GPIO_DT_SPEC_GET(DT_PATH(zephyr_user), periph_5v_power_gpios);
const device* const kUsb = DEVICE_DT_GET(DT_NODELABEL(cdc_acm_uart0));

RING_BUF_DECLARE(g_tx_ring, 8192);
RING_BUF_DECLARE(g_rx_ring, 2048);

void usb_isr(const device* dev, void*) {
    while (uart_irq_update(dev) > 0 && uart_irq_is_pending(dev) > 0) {
        if (uart_irq_rx_ready(dev) > 0) {
            uint8_t buf[64];
            const int n = uart_fifo_read(dev, buf, sizeof(buf));
            if (n > 0) {
                ring_buf_put(&g_rx_ring, buf, static_cast<uint32_t>(n));
            }
        }
        if (uart_irq_tx_ready(dev) > 0) {
            uint8_t* data = nullptr;
            const uint32_t n = ring_buf_get_claim(&g_tx_ring, &data, 64);
            if (n == 0) {
                uart_irq_tx_disable(dev);
            } else {
                const int sent = uart_fifo_fill(dev, data, static_cast<int>(n));
                ring_buf_get_finish(&g_tx_ring, sent > 0 ? static_cast<uint32_t>(sent) : 0U);
            }
        }
    }
}

// MavlinkHandler byte writer. A frame that does not fit (host not reading)
// is dropped whole rather than truncated.
void usb_write(const uint8_t* data, size_t len, void*) {
    const unsigned int key = irq_lock();
    if (ring_buf_space_get(&g_tx_ring) >= len) {
        ring_buf_put(&g_tx_ring, data, static_cast<uint32_t>(len));
    }
    irq_unlock(key);
    uart_irq_tx_enable(kUsb);
}

void power_rails_on() {
    // Sensors start unpowered; switch the rail on after the 5 V
    // peripheral rail, as a clean power-up for the IMUs and baros.
    gpio_pin_configure_dt(&kSensorsPower, GPIO_OUTPUT_INACTIVE);
    gpio_pin_configure_dt(&kPeriph5vPower, GPIO_OUTPUT_ACTIVE);
    k_msleep(20);
    gpio_pin_set_dt(&kSensorsPower, 1);
}

} // namespace

int main() {
    power_rails_on();
    gpio_pin_configure_dt(&kLed, GPIO_OUTPUT_INACTIVE);

    static apx::gcs::MavlinkHandler mav(1, 1);
    mav.init(); // registers the parameter defaults
    static apx::modes::ModeManager modes;
    mav.set_mode_manager(&modes);
    mav.set_vehicle_type(MAV_TYPE_HEXAROTOR);

    // Report only what works on this build.
    mav.set_sensor_status(0, 0, 0);
    mav.set_estimates_valid(false, false);
    mav.set_arming_blocked("Arming refused: APX bring-up build has no sensors or motor outputs yet");
    mav.set_vehicle_state(0.0f, 0.0f, 0.0f, 0.0, 0.0, 0.0f, 0.0f, 0.0f, 0.0f, 0.0f,
                          -1.0f, -1.0f, -1, false, MAV_MODE_FLAG_CUSTOM_MODE_ENABLED, 0);
    mav.set_raw_sensor_telemetry(apx::gcs::RawSensorTelemetry{}); // GPS_RAW_INT: no GPS

    mav.set_byte_writer(usb_write, nullptr);
    if (device_is_ready(kUsb)) {
        uart_irq_callback_user_data_set(kUsb, usb_isr, nullptr);
        uart_irq_rx_enable(kUsb);
    }

    static struct k_timer tick;
    k_timer_init(&tick, nullptr, nullptr);
    k_timer_start(&tick, K_USEC(kLoopPeriodUs), K_USEC(kLoopPeriodUs));

    uint32_t loops = 0;
    uint64_t next_notice_ms = 3000;
    while (true) {
        k_timer_status_sync(&tick);

        uint8_t buf[128];
        uint32_t got;
        while ((got = ring_buf_get(&g_rx_ring, buf, sizeof(buf))) > 0) {
            mav.receive_bytes(buf, got);
        }

        mav.set_custom_mode(apx::modes::ModeManager::to_custom_mode_number(modes.current_id()));
        mav.update();

        if (apx::kernel::now_ms() >= next_notice_ms) {
            mav.send_statustext(MAV_SEVERITY_WARNING,
                                "APX bring-up build: no sensors or motor outputs yet, arming disabled");
            next_notice_ms += kNoticePeriodS * 1000ULL;
        }

        if (++loops % (kLoopHz / 2) == 0) {
            gpio_pin_toggle_dt(&kLed); // 1 Hz blink: firmware running
        }
    }
    return 0;
}
```

## src/board_zephyr.cpp
```c
// SPDX-License-Identifier: CC-BY-NC-4.0
// Copyright (c) 2026 Savita Pawar <savitapawar0402@gmail.com>
// Author: Savita Pawar (SVPR94)
// Created: 2026
// APX board interface (apx/firmware/board.hpp) for every Zephyr board.
//
// Nothing here is board-specific: each board describes its hardware in its
// devicetree, and this file reads it.
//
//   aliases  { led0 = &status_led; }             status LED (optional)
//   chosen   { apx,gcs-uart = &cdc_acm_uart0; }  GCS/MAVLink link (USB CDC or UART)
//   chosen   { apx,iomcu-uart = &usart6; }       IO coprocessor link (optional, 1.5 Mbaud)
//   zephyr,user {
//       power-enable-gpios = <...>, <...>;        rails switched on in this order (optional)
//       power-enable-delay-ms = <20>;             settle time after each rail
//       apj-board-id = <1063>;                    .apj bootloader board id (optional, CMake)
//   };
//   apx_boot_control: boot-control@...           RAM shared with the bootloader (optional)
//
// So adding a board from another manufacturer needs board files only
// (platforms/zephyr/boards/<vendor>/<board>/), no code.

#include <zephyr/devicetree.h>
#include <zephyr/drivers/gpio.h>
#include <zephyr/kernel.h>
#include <zephyr/sys/reboot.h>

#include "apx/bootloader/boot_control.hpp"
#include "apx/firmware/board.hpp"
#include "uart_zephyr.hpp"

#define APX_USER_NODE DT_PATH(zephyr_user)

namespace apx::board {
namespace {

#if DT_NODE_EXISTS(DT_ALIAS(led0))
#define APX_HAS_STATUS_LED 1
const gpio_dt_spec kStatusLed = GPIO_DT_SPEC_GET(DT_ALIAS(led0), gpios);
bool g_led_on = false;
#endif

#if DT_NODE_HAS_PROP(APX_USER_NODE, power_enable_gpios)
#define APX_HAS_POWER_RAILS 1
const gpio_dt_spec kPowerRails[] = {
    DT_FOREACH_PROP_ELEM_SEP(APX_USER_NODE, power_enable_gpios, GPIO_DT_SPEC_GET_BY_IDX, (, ))};
constexpr int32_t kPowerDelayMs = DT_PROP_OR(APX_USER_NODE, power_enable_delay_ms, 10);
#endif

const BoardInfo kInfo{CONFIG_BOARD, CONFIG_BOARD_TARGET, "zephyr"};

#if DT_HAS_CHOSEN(apx_gcs_uart)
apx::hal::zephyr::ZephyrUart& gcs_uart() {
    static apx::hal::zephyr::ZephyrUart uart(DEVICE_DT_GET(DT_CHOSEN(apx_gcs_uart)));
    return uart;
}
bool g_gcs_ok = false;
#endif

#if DT_HAS_CHOSEN(apx_iomcu_uart)
apx::hal::zephyr::ZephyrUart& iomcu_uart() {
    static apx::hal::zephyr::ZephyrUart uart(DEVICE_DT_GET(DT_CHOSEN(apx_iomcu_uart)));
    return uart;
}
bool g_iomcu_ok = false;
#endif

} // namespace

bool init() {
    bool ok = true;
#if defined(APX_HAS_POWER_RAILS)
    // All rails off first, then on in devicetree order with settle time,
    // so sensors see a clean power-up.
    for (const auto& rail : kPowerRails) {
        ok &= gpio_pin_configure_dt(&rail, GPIO_OUTPUT_INACTIVE) == 0;
    }
    for (const auto& rail : kPowerRails) {
        gpio_pin_set_dt(&rail, 1);
        k_msleep(kPowerDelayMs);
    }
#endif
#if defined(APX_HAS_STATUS_LED)
    ok &= gpio_pin_configure_dt(&kStatusLed, GPIO_OUTPUT_INACTIVE) == 0;
#endif
#if DT_HAS_CHOSEN(apx_gcs_uart)
    g_gcs_ok = gcs_uart().init(0); // 0: keep the devicetree baud rate
    ok &= g_gcs_ok;
#else
    ok = false; // no GCS link chosen in the devicetree
#endif
#if DT_HAS_CHOSEN(apx_iomcu_uart)
    g_iomcu_ok = iomcu_uart().init(0); // devicetree speed (1.5 Mbaud)
    ok &= g_iomcu_ok;
#endif
    return ok;
}

const BoardInfo& info() { return kInfo; }

void set_status_led(bool on) {
#if defined(APX_HAS_STATUS_LED)
    g_led_on = on;
    gpio_pin_set_dt(&kStatusLed, on ? 1 : 0);
#else
    (void)on;
#endif
}

void toggle_status_led() {
#if defined(APX_HAS_STATUS_LED)
    set_status_led(!g_led_on);
#endif
}

void reboot(bool to_bootloader) {
#if DT_NODE_EXISTS(DT_NODELABEL(apx_boot_control))
    auto* bc = reinterpret_cast<volatile apx::bootloader::BootControl*>(
        DT_REG_ADDR(DT_NODELABEL(apx_boot_control)));
    apx::bootloader::boot_control_set(bc, to_bootloader ? apx::bootloader::BootRequest::StayInBootloader
                                                        : apx::bootloader::BootRequest::None);
#else
    (void)to_bootloader; // no bootloader handshake on this board
#endif
    sys_reboot(SYS_REBOOT_WARM);
    while (true) {
    }
}

apx::hal::IHalUart* iomcu_link() {
#if DT_HAS_CHOSEN(apx_iomcu_uart)
    return g_iomcu_ok ? &iomcu_uart() : nullptr;
#else
    return nullptr;
#endif
}

apx::hal::IHalUart* gcs_link() {
#if DT_HAS_CHOSEN(apx_gcs_uart)
    return g_gcs_ok ? &gcs_uart() : nullptr;
#else
    return nullptr;
#endif
}

} // namespace apx::board
```
