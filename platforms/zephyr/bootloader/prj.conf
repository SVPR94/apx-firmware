## CMakeLists.txt
```
# SPDX-License-Identifier: CC-BY-NC-4.0
# Copyright (c) 2026 Savita Pawar <savitapawar0402@gmail.com>
# Author: Savita Pawar (SVPR94)
# Created: 2026
# APX bootloader - Zephyr port. Built together with the flight firmware by
# sysbuild (platforms/zephyr/app/sysbuild.cmake); not meant to be built on
# its own. Speaks the serial upload protocol in bootloader/ (portable core).

cmake_minimum_required(VERSION 3.20.0)

find_package(Zephyr REQUIRED HINTS $ENV{ZEPHYR_BASE})
project(apx_bootloader LANGUAGES C CXX)

get_filename_component(APX_ROOT ${CMAKE_CURRENT_LIST_DIR}/../../.. ABSOLUTE)
include(${APX_ROOT}/bootloader/sources.cmake)

execute_process(COMMAND git -C ${APX_ROOT} rev-parse --short HEAD
                OUTPUT_VARIABLE APX_GIT OUTPUT_STRIP_TRAILING_WHITESPACE ERROR_QUIET)
if(NOT APX_GIT)
    set(APX_GIT "unknown")
endif()

target_sources(app PRIVATE
    src/main.cpp
    src/boot_jump.cpp
    src/port_zephyr.cpp
    ${APX_ROOT}/hal/ports/zephyr/uart_zephyr.cpp
    ${APX_BOOTLOADER_SOURCES}
)
target_include_directories(app PRIVATE
    ${APX_BOOTLOADER_INCLUDE_DIR}
    ${APX_ROOT}/hal/include
    ${APX_ROOT}/hal/ports/zephyr
)
target_compile_definitions(app PRIVATE APX_BL_VERSION="1.0-${APX_GIT}")

# Memory report (last step): must fit the bootloader partition.
add_custom_target(apx_bootloader_memory_report ALL
    COMMAND ${PYTHON_EXECUTABLE} ${APX_ROOT}/tools/fw_memory_report.py
            --elf ${CMAKE_BINARY_DIR}/zephyr/zephyr.elf
            --map ${CMAKE_BINARY_DIR}/zephyr/zephyr.map
            --bin ${CMAKE_BINARY_DIR}/zephyr/zephyr.bin
            --name "${BOARD} bootloader (Zephyr)"
            --top 5
            --out-txt ${CMAKE_BINARY_DIR}/zephyr/apx_memory_report.txt
            --out-json ${CMAKE_BINARY_DIR}/zephyr/apx_memory_report.json
    COMMENT "APX bootloader: memory analysis"
    VERBATIM
)
add_dependencies(apx_bootloader_memory_report zephyr_final)
```

## Kconfig
```
# SPDX-License-Identifier: CC-BY-NC-4.0
# Copyright (c) 2026 Savita Pawar <savitapawar0402@gmail.com>
# Author: Savita Pawar (SVPR94)
# Created: 2026
mainmenu "APX bootloader"

config APX_BL_BOOT_DELAY_MS
	int "Time to wait for a ground station after power-up (ms)"
	default 2000
	help
	  With a valid application, the bootloader listens this long after a
	  normal reset before starting it. Long enough for the USB device to
	  enumerate and a ground station to send the first command.

config APX_BL_STAY_TIMEOUT_S
	int "Time to wait after a reboot-to-bootloader request (s)"
	default 30

config APX_BL_IDLE_TIMEOUT_S
	int "Start the application after this long without commands (s)"
	default 30
	help
	  Applies once a ground station has talked to the bootloader and the
	  application is valid.

config APX_BL_UART_BAUD
	int "Baud rate when the bootloader link is a UART"
	default 115200
	help
	  Ignored for USB CDC links. Ground-station uploaders use 115200 for
	  the bootloader by default.

source "Kconfig.zephyr"
```

## prj.conf
```kconfig
# SPDX-License-Identifier: CC-BY-NC-4.0
# Copyright (c) 2026 Savita Pawar <savitapawar0402@gmail.com>
# Author: Savita Pawar (SVPR94)
# Created: 2026
# APX bootloader - Zephyr configuration common to every board.
# USB CDC settings for USB boards live in boards/<board>.conf.

CONFIG_CPP=y
CONFIG_STD_CPP17=y
# Full C++ library (the shared HAL serial interface uses <functional>);
# newlib-nano keeps the image small.
CONFIG_REQUIRES_FULL_LIBCPP=y
CONFIG_NEWLIB_LIBC=y
CONFIG_NEWLIB_LIBC_NANO=y

CONFIG_GPIO=y
CONFIG_SERIAL=y
CONFIG_UART_INTERRUPT_DRIVEN=y
CONFIG_RING_BUFFER=y
CONFIG_FLASH=y
CONFIG_FLASH_PAGE_LAYOUT=y
CONFIG_HWINFO=y
CONFIG_REBOOT=y

# Flash is read back right after programming (CRC): keep the data cache off
# so reads always see flash, not stale cache lines.
CONFIG_DCACHE=n

CONFIG_MAIN_STACK_SIZE=4096
CONFIG_CONSOLE=n
CONFIG_UART_CONSOLE=n
CONFIG_LOG=n
CONFIG_SIZE_OPTIMIZATIONS=y

# Link into the bootloader partition (app.overlay picks it).
CONFIG_USE_DT_CODE_PARTITION=y
```

## boards/apx_h743_pro.conf
```kconfig
# SPDX-License-Identifier: CC-BY-NC-4.0
# Copyright (c) 2026 Savita Pawar <savitapawar0402@gmail.com>
# Author: Savita Pawar (SVPR94)
# Created: 2026
# Bootloader link: USB CDC-ACM (the board's apx,gcs-uart).
# Ground stations that detect bootloaders by USB VID/PID may need the
# board's own IDs here (CONFIG_CDC_ACM_SERIAL_VID / _PID).
CONFIG_UART_LINE_CTRL=y
CONFIG_USB_DEVICE_STACK_NEXT=y
CONFIG_USBD_CDC_ACM_CLASS=y
CONFIG_CDC_ACM_SERIAL_INITIALIZE_AT_BOOT=y
CONFIG_CDC_ACM_SERIAL_MANUFACTURER_STRING="APX"
CONFIG_CDC_ACM_SERIAL_PRODUCT_STRING="APX Bootloader (H743 Pro)"
```

## boards/ark_v6x.conf
```kconfig
# SPDX-License-Identifier: CC-BY-NC-4.0
# Copyright (c) 2026 Savita Pawar <savitapawar0402@gmail.com>
# Author: Savita Pawar (SVPR94)
# Created: 2026
# ARK V6X: bootloader link over USB CDC-ACM. Generated by tools/import_board.py from the board's hardware description; re-run it rather than editing.
CONFIG_UART_LINE_CTRL=y
CONFIG_USB_DEVICE_STACK_NEXT=y
CONFIG_USBD_CDC_ACM_CLASS=y
CONFIG_CDC_ACM_SERIAL_INITIALIZE_AT_BOOT=y
CONFIG_CDC_ACM_SERIAL_MANUFACTURER_STRING="APX"
CONFIG_CDC_ACM_SERIAL_PRODUCT_STRING="APX Bootloader (ARK V6X)"
```

## boards/cuav_7_nano.conf
```kconfig
# SPDX-License-Identifier: CC-BY-NC-4.0
# Copyright (c) 2026 Savita Pawar <savitapawar0402@gmail.com>
# Author: Savita Pawar (SVPR94)
# Created: 2026
# CUAV 7-Nano: bootloader link over USB CDC-ACM. Generated by tools/import_board.py from the board's hardware description; re-run it rather than editing.
CONFIG_UART_LINE_CTRL=y
CONFIG_USB_DEVICE_STACK_NEXT=y
CONFIG_USBD_CDC_ACM_CLASS=y
CONFIG_CDC_ACM_SERIAL_INITIALIZE_AT_BOOT=y
CONFIG_CDC_ACM_SERIAL_MANUFACTURER_STRING="APX"
CONFIG_CDC_ACM_SERIAL_PRODUCT_STRING="APX Bootloader (CUAV 7-Nano)"
```

## boards/cuav_nora.conf
```kconfig
# SPDX-License-Identifier: CC-BY-NC-4.0
# Copyright (c) 2026 Savita Pawar <savitapawar0402@gmail.com>
# Author: Savita Pawar (SVPR94)
# Created: 2026
# CUAV Nora: bootloader link over USB CDC-ACM. Generated by tools/import_board.py from the board's hardware description; re-run it rather than editing.
CONFIG_UART_LINE_CTRL=y
CONFIG_USB_DEVICE_STACK_NEXT=y
CONFIG_USBD_CDC_ACM_CLASS=y
CONFIG_CDC_ACM_SERIAL_INITIALIZE_AT_BOOT=y
CONFIG_CDC_ACM_SERIAL_MANUFACTURER_STRING="APX"
CONFIG_CDC_ACM_SERIAL_PRODUCT_STRING="APX Bootloader (CUAV Nora)"
```

## boards/cuav_x7.conf
```kconfig
# SPDX-License-Identifier: CC-BY-NC-4.0
# Copyright (c) 2026 Savita Pawar <savitapawar0402@gmail.com>
# Author: Savita Pawar (SVPR94)
# Created: 2026
# CUAV X7 / X7 Pro: bootloader link over USB CDC-ACM. Generated by tools/import_board.py from the board's hardware description; re-run it rather than editing.
CONFIG_UART_LINE_CTRL=y
CONFIG_USB_DEVICE_STACK_NEXT=y
CONFIG_USBD_CDC_ACM_CLASS=y
CONFIG_CDC_ACM_SERIAL_INITIALIZE_AT_BOOT=y
CONFIG_CDC_ACM_SERIAL_MANUFACTURER_STRING="APX"
CONFIG_CDC_ACM_SERIAL_PRODUCT_STRING="APX Bootloader (CUAV X7 / X7 Pro)"
```

## boards/cube_orange.conf
```kconfig
# SPDX-License-Identifier: CC-BY-NC-4.0
# Copyright (c) 2026 Savita Pawar <savitapawar0402@gmail.com>
# Author: Savita Pawar (SVPR94)
# Created: 2026
# CubePilot Cube Orange: bootloader link over USB CDC-ACM. Generated by tools/import_board.py from the board's hardware description; re-run it rather than editing.
CONFIG_UART_LINE_CTRL=y
CONFIG_USB_DEVICE_STACK_NEXT=y
CONFIG_USBD_CDC_ACM_CLASS=y
CONFIG_CDC_ACM_SERIAL_INITIALIZE_AT_BOOT=y
CONFIG_CDC_ACM_SERIAL_MANUFACTURER_STRING="APX"
CONFIG_CDC_ACM_SERIAL_PRODUCT_STRING="APX Bootloader (CubePilot Cube Orange)"
# Board's USB ids, so ground stations recognise it
CONFIG_CDC_ACM_SERIAL_VID=0x2DAE
CONFIG_CDC_ACM_SERIAL_PID=0x1016
```

## app.overlay
```dts
/* SPDX-License-Identifier: CC-BY-NC-4.0 */
/* The bootloader image lives in the board's bootloader partition. */
/ {
	chosen {
		zephyr,code-partition = &bootloader_partition;
	};
};
```

## src/main.cpp
```c
// SPDX-License-Identifier: CC-BY-NC-4.0
// Copyright (c) 2026 Savita Pawar <savitapawar0402@gmail.com>
// Author: Savita Pawar (SVPR94)
// Created: 2026
// APX bootloader (Zephyr port) - boot policy.
//
//   power-up, valid app       listen CONFIG_APX_BL_BOOT_DELAY_MS for a ground
//                             station, then start the application
//   app asked for bootloader  (MAVLink reboot-to-bootloader) listen up to
//                             CONFIG_APX_BL_STAY_TIMEOUT_S
//   no valid app              stay in the bootloader until one is uploaded
//   upload finished (REBOOT)  start the new application
//
// The link is the board's chosen apx,bootloader-uart, else its apx,gcs-uart
// (USB CDC or a UART). The status LED blinks fast while in the bootloader.

#include <cstring>

#include <zephyr/devicetree.h>
#include <zephyr/kernel.h>

#include "apx/bootloader/protocol.hpp"
#include "boot_jump.hpp"
#include "port_zephyr.hpp"
#include "uart_zephyr.hpp"

#if DT_HAS_CHOSEN(apx_bootloader_uart)
#define APX_BL_LINK DT_CHOSEN(apx_bootloader_uart)
#elif DT_HAS_CHOSEN(apx_gcs_uart)
#define APX_BL_LINK DT_CHOSEN(apx_gcs_uart)
#else
#error "APX bootloader: choose apx,bootloader-uart or apx,gcs-uart in the board devicetree"
#endif
#define APX_BL_LINK_IS_UART (!DT_NODE_HAS_COMPAT(APX_BL_LINK, zephyr_cdc_acm_uart))

#define APX_USER_NODE DT_PATH(zephyr_user)
#if !DT_NODE_HAS_PROP(APX_USER_NODE, apj_board_id)
#error "APX bootloader: set zephyr,user { apj-board-id = <N>; } in the board devicetree"
#endif

using namespace apx::bootloader;
using namespace apx::bootloader::zephyr;

namespace {

uint32_t chip_id() {
#if defined(CONFIG_SOC_SERIES_STM32H7X)
    return *reinterpret_cast<const volatile uint32_t*>(0x5C001000u); // DBGMCU_IDCODE
#else
    return 0;
#endif
}

const char* chip_description() {
    static char text[48];
    const char* rev = "?";
#if defined(CONFIG_SOC_SERIES_STM32H7X)
    switch (chip_id() >> 16) {
    case 0x1001: rev = "Z"; break;
    case 0x1003: rev = "Y"; break;
    case 0x2001: rev = "X"; break;
    case 0x2003: rev = "V"; break;
    default: break;
    }
#endif
    // "<soc>,<revision>" without pulling in printf
    std::strncpy(text, CONFIG_SOC, sizeof(text) - 3);
    text[sizeof(text) - 3] = '\0';
    std::strcat(text, ",");
    std::strcat(text, rev);
    return text;
}

} // namespace

int main() {
    static apx::hal::zephyr::ZephyrUart link(DEVICE_DT_GET(APX_BL_LINK));
    link.init(APX_BL_LINK_IS_UART ? CONFIG_APX_BL_UART_BAUD : 0);
    static ZephyrPort port(link, APX_BL_LINK_IS_UART);

    const Identity identity{
        DT_PROP(APX_USER_NODE, apj_board_id),
        DT_PROP_OR(APX_USER_NODE, board_revision, 0),
        app_size(),
        chip_id(),
        chip_description(),
        "APX bootloader " APX_BL_VERSION " (" CONFIG_BOARD_TARGET ")",
    };
    static Protocol protocol(port, identity);

    const bool stay = early_request() == BootRequest::StayInBootloader;
    uint32_t first_contact_ms = stay ? CONFIG_APX_BL_STAY_TIMEOUT_S * 1000U : CONFIG_APX_BL_BOOT_DELAY_MS;
    while (true) {
        const bool have_app = app_valid();
        protocol.run(have_app ? first_contact_ms : 0, have_app ? CONFIG_APX_BL_IDLE_TIMEOUT_S * 1000U : 0);
        if (app_valid()) {
            link.flush();
            start_application(); // does not return
        }
        first_contact_ms = 0; // no valid application: keep serving
    }
    return 0;
}
```

## src/boot_jump.cpp
```c
// SPDX-License-Identifier: CC-BY-NC-4.0
// Copyright (c) 2026 Savita Pawar <savitapawar0402@gmail.com>
// Author: Savita Pawar (SVPR94)
// Created: 2026
// APX bootloader (Zephyr port): early boot hook and jump to the application.

#include "boot_jump.hpp"

#include <zephyr/devicetree.h>
#include <zephyr/init.h>
#include <zephyr/kernel.h>
#include <zephyr/sys/reboot.h>
#include <zephyr/sys/util.h>

#include <cmsis_core.h>

#if defined(CONFIG_SOC_FAMILY_STM32)
#include <stm32_ll_rcc.h>
#endif

#define APX_FLASH_NODE DT_CHOSEN(zephyr_flash)
#define APX_APP_PART DT_NODELABEL(app_partition)
#define APX_BOOT_CTL DT_NODELABEL(apx_boot_control)

#if !DT_NODE_EXISTS(APX_APP_PART)
#error "APX bootloader: the board devicetree needs an app_partition flash partition"
#endif
#if !DT_NODE_EXISTS(APX_BOOT_CTL)
#error "APX bootloader: the board devicetree needs an apx_boot_control RAM node"
#endif

namespace apx::bootloader::zephyr {
namespace {

BootRequest g_early_request = BootRequest::None;

bool in_range(uint32_t v, uint32_t base, uint32_t size) { return v >= base && v <= base + size; }

// True after a power-on or brown-out reset: RAM (and its ECC) is not
// initialised, so the boot control block must not be read. Also saves and
// clears the reset flags so the next reset is classified correctly.
bool cold_reset_and_clear_flags(uint32_t& flags) {
#if defined(CONFIG_SOC_FAMILY_STM32) && defined(RCC_RSR_PORRSTF)   /* STM32H7 */
    flags = RCC->RSR;
    const bool cold = (flags & (RCC_RSR_PORRSTF | RCC_RSR_BORRSTF)) != 0;
    LL_RCC_ClearResetFlags();
    return cold;
#elif defined(CONFIG_SOC_FAMILY_STM32) && defined(RCC_CSR_PORRSTF)  /* STM32F4 */
    flags = RCC->CSR;
    const bool cold = (flags & (RCC_CSR_PORRSTF | RCC_CSR_BORRSTF)) != 0;
    LL_RCC_ClearResetFlags();
    return cold;
#else
    flags = 0;
    return true; // unknown reset cause: never trust RAM contents
#endif
}

[[noreturn]] void jump(uint32_t base) {
    const auto* vectors = reinterpret_cast<const volatile uint32_t*>(base);
    const uint32_t sp = vectors[0];
    const uint32_t entry = vectors[1];

    __disable_irq();
    SysTick->CTRL = 0;
    SysTick->VAL = 0;
    SCB->ICSR = SCB_ICSR_PENDSTCLR_Msk | SCB_ICSR_PENDSVCLR_Msk;
    for (size_t i = 0; i < ARRAY_SIZE(NVIC->ICER); ++i) {
        NVIC->ICER[i] = 0xFFFFFFFFu;
        NVIC->ICPR[i] = 0xFFFFFFFFu;
    }
#if defined(__MPU_PRESENT) && __MPU_PRESENT
    MPU->CTRL = 0;
#endif
#if defined(__DCACHE_PRESENT) && __DCACHE_PRESENT
    if (SCB->CCR & SCB_CCR_DC_Msk) {
        SCB_DisableDCache();
    }
#endif
#if defined(__ICACHE_PRESENT) && __ICACHE_PRESENT
    if (SCB->CCR & SCB_CCR_IC_Msk) {
        SCB_DisableICache();
    }
#endif
    SCB->VTOR = base;
    __DSB();
    __ISB();
    // Reset-like core state: MSP from the image, privileged thread mode on
    // MSP, no FPU context, interrupts unmasked (every source is disabled).
    __set_MSP(sp);
    __set_CONTROL(0);
    __set_BASEPRI(0);
    __ISB();
    __enable_irq();
    reinterpret_cast<void (*)()>(entry)();
    while (true) {
    }
}

// Runs before any driver: either jump straight to the application (clean
// peripheral state) or record the request for main().
int early_boot_hook() {
    volatile BootControl* bc = boot_control();
    uint32_t reset_flags = 0;
    if (cold_reset_and_clear_flags(reset_flags)) {
        // Initialise the whole block with word writes (sets RAM ECC).
        auto* words = reinterpret_cast<volatile uint32_t*>(bc);
        for (size_t i = 0; i < DT_REG_SIZE(APX_BOOT_CTL) / 4; ++i) {
            words[i] = 0;
        }
        g_early_request = BootRequest::None;
    } else {
        g_early_request = boot_control_take(bc);
    }
    bc->reserved = reset_flags; // reset cause, for the application
    if (g_early_request == BootRequest::StartApplication && app_valid()) {
        jump(app_base_address());
    }
    return 0;
}

} // namespace

uint32_t app_offset() { return DT_REG_ADDR(APX_APP_PART); }
uint32_t app_size() { return DT_REG_SIZE(APX_APP_PART); }
uint32_t app_base_address() { return DT_REG_ADDR(APX_FLASH_NODE) + app_offset(); }

bool app_valid() {
    const auto* vectors = reinterpret_cast<const volatile uint32_t*>(app_base_address());
    const uint32_t sp = vectors[0];
    const uint32_t entry = vectors[1];
    bool sp_ok = in_range(sp, DT_REG_ADDR(DT_CHOSEN(zephyr_sram)), DT_REG_SIZE(DT_CHOSEN(zephyr_sram)));
#if DT_NODE_EXISTS(DT_CHOSEN(zephyr_dtcm))
    sp_ok = sp_ok || in_range(sp, DT_REG_ADDR(DT_CHOSEN(zephyr_dtcm)), DT_REG_SIZE(DT_CHOSEN(zephyr_dtcm)));
#endif
    const bool entry_ok = (entry & 1u) != 0 && entry > app_base_address() &&
                          entry < app_base_address() + app_size();
    return sp_ok && (sp & 3u) == 0 && entry_ok;
}

volatile BootControl* boot_control() {
    return reinterpret_cast<volatile BootControl*>(DT_REG_ADDR(APX_BOOT_CTL));
}

BootRequest early_request() { return g_early_request; }

void start_application() {
    boot_control_set(boot_control(), BootRequest::StartApplication);
    sys_reboot(SYS_REBOOT_WARM);
    while (true) {
    }
}

} // namespace apx::bootloader::zephyr

namespace {
int apx_early_boot() { return apx::bootloader::zephyr::early_boot_hook(); }
} // namespace

SYS_INIT(apx_early_boot, PRE_KERNEL_1, 0);
```

## src/boot_jump.hpp
```c
#pragma once
// SPDX-License-Identifier: CC-BY-NC-4.0
// Copyright (c) 2026 Savita Pawar <savitapawar0402@gmail.com>
// Author: Savita Pawar (SVPR94)
// Created: 2026
// APX bootloader (Zephyr port): application image checks, boot control
// access and the hand-over to the application.

#include <cstddef>
#include <cstdint>

#include "apx/bootloader/boot_control.hpp"

namespace apx::bootloader::zephyr {

uint32_t app_base_address();   // absolute address of the application vector table
uint32_t app_offset();         // offset of the application area in flash
uint32_t app_size();

// True if the application area starts with a plausible vector table
// (stack pointer in RAM, Thumb reset handler inside the area). The first
// program unit is written last during an upload, so a partial upload fails
// this check.
bool app_valid();

// Shared RAM block (devicetree node apx_boot_control).
volatile BootControl* boot_control();

// Pending request recorded by the early boot hook (it reads and clears the
// shared block before the kernel starts).
BootRequest early_request();

// Request a clean start of the application: record it in the boot control
// block and reset; the early boot hook jumps before any driver starts.
[[noreturn]] void start_application();

} // namespace apx::bootloader::zephyr
```

## src/port_zephyr.cpp
```c
// SPDX-License-Identifier: CC-BY-NC-4.0
// Copyright (c) 2026 Savita Pawar <savitapawar0402@gmail.com>
// Author: Savita Pawar (SVPR94)
// Created: 2026
// APX bootloader (Zephyr port): Port implementation.

#include "port_zephyr.hpp"

#include <cstring>

#include <zephyr/drivers/flash.h>
#include <zephyr/drivers/hwinfo.h>
#include <zephyr/kernel.h>

#include "boot_jump.hpp"

namespace apx::bootloader::zephyr {
namespace {

#if DT_NODE_EXISTS(DT_ALIAS(led0))
const gpio_dt_spec kLed = GPIO_DT_SPEC_GET(DT_ALIAS(led0), gpios);
#endif

struct EraseCtx {
    const struct device* flash;
    off_t begin;
    off_t end;
    bool ok;
};

bool page_blank(const struct device* flash, off_t start, size_t size) {
    uint8_t buf[256];
    for (size_t off = 0; off < size; off += sizeof(buf)) {
        const size_t n = (size - off) < sizeof(buf) ? (size - off) : sizeof(buf);
        if (flash_read(flash, start + static_cast<off_t>(off), buf, n) != 0) {
            return false;
        }
        for (size_t i = 0; i < n; ++i) {
            if (buf[i] != 0xFF) {
                return false;
            }
        }
    }
    return true;
}

// Erase the pages (sectors) of the application area; already blank pages are
// skipped, which makes re-flashing a small image much faster.
bool erase_page(const struct flash_pages_info* info, void* data) {
    auto* ctx = static_cast<EraseCtx*>(data);
    if (info->start_offset + static_cast<off_t>(info->size) <= ctx->begin || info->start_offset >= ctx->end) {
        return true; // outside the application area
    }
    if (!page_blank(ctx->flash, info->start_offset, info->size)) {
        if (flash_erase(ctx->flash, info->start_offset, info->size) != 0) {
            ctx->ok = false;
            return false;
        }
    }
    return true;
}

} // namespace

ZephyrPort::ZephyrPort(apx::hal::zephyr::ZephyrUart& link, bool link_is_uart)
    : m_link(link), m_link_is_uart(link_is_uart),
      m_flash(DEVICE_DT_GET(DT_CHOSEN(zephyr_flash_controller))) {
#if DT_NODE_EXISTS(DT_ALIAS(led0))
    gpio_pin_configure_dt(&kLed, GPIO_OUTPUT_INACTIVE);
#endif
}

size_t ZephyrPort::read(uint8_t* buf, size_t max_len) {
    const int n = m_link.read(buf, max_len);
    return n > 0 ? static_cast<size_t>(n) : 0;
}

void ZephyrPort::write(const uint8_t* buf, size_t len) {
    // ZephyrUart queues whole buffers only; wait for room if the host is slow.
    for (int tries = 0; tries < 200 && m_link.write(buf, len) <= 0; ++tries) {
        k_msleep(1);
    }
}

void ZephyrPort::flush() { m_link.flush(); }

bool ZephyrPort::set_baud(uint32_t baud) {
    if (!m_link_is_uart) {
        return false; // USB CDC: baud rate has no meaning
    }
    m_link.set_baudrate(baud);
    return true;
}

uint32_t ZephyrPort::millis() { return k_uptime_get_32(); }

void ZephyrPort::idle() {
    k_msleep(1);
#if DT_NODE_EXISTS(DT_ALIAS(led0))
    const uint32_t now = k_uptime_get_32();
    if (now - m_last_blink >= 100) { // fast 5 Hz blink: "in bootloader"
        m_last_blink = now;
        gpio_pin_toggle_dt(&kLed);
    }
#endif
}

bool ZephyrPort::erase_app() {
    if (!device_is_ready(m_flash)) {
        return false;
    }
    EraseCtx ctx{m_flash, static_cast<off_t>(app_offset()), static_cast<off_t>(app_offset() + app_size()), true};
    flash_page_foreach(m_flash, erase_page, &ctx);
    return ctx.ok;
}

bool ZephyrPort::program(uint32_t offset, const uint8_t* data, size_t len) {
    if (offset + len > app_size()) {
        return false;
    }
    return flash_write(m_flash, static_cast<off_t>(app_offset() + offset), data, len) == 0;
}

void ZephyrPort::read_app(uint32_t offset, uint8_t* data, size_t len) {
    if (flash_read(m_flash, static_cast<off_t>(app_offset() + offset), data, len) != 0) {
        std::memset(data, 0xFF, len);
    }
}

size_t ZephyrPort::program_unit() const { return flash_get_write_block_size(m_flash); }

bool ZephyrPort::serial_word(uint32_t offset, uint32_t& word) {
    uint8_t id[16];
    const ssize_t n = hwinfo_get_device_id(id, sizeof(id));
    if (n <= 0 || offset + 4 > static_cast<uint32_t>(n)) {
        return false;
    }
    std::memcpy(&word, &id[offset], 4);
    return true;
}

} // namespace apx::bootloader::zephyr
```

## src/port_zephyr.hpp
```c
#pragma once
// SPDX-License-Identifier: CC-BY-NC-4.0
// Copyright (c) 2026 Savita Pawar <savitapawar0402@gmail.com>
// Author: Savita Pawar (SVPR94)
// Created: 2026
// APX bootloader (Zephyr port): Port implementation on Zephyr's flash,
// UART/USB CDC and GPIO APIs.

#include <zephyr/device.h>
#include <zephyr/drivers/gpio.h>

#include "apx/bootloader/port.hpp"
#include "uart_zephyr.hpp"

namespace apx::bootloader::zephyr {

class ZephyrPort final : public Port {
public:
    ZephyrPort(apx::hal::zephyr::ZephyrUart& link, bool link_is_uart);

    size_t read(uint8_t* buf, size_t max_len) override;
    void write(const uint8_t* buf, size_t len) override;
    void flush() override;
    bool set_baud(uint32_t baud) override;
    uint32_t millis() override;
    void idle() override;
    bool erase_app() override;
    bool program(uint32_t offset, const uint8_t* data, size_t len) override;
    void read_app(uint32_t offset, uint8_t* data, size_t len) override;
    size_t program_unit() const override;
    bool serial_word(uint32_t offset, uint32_t& word) override;

private:
    apx::hal::zephyr::ZephyrUart& m_link;
    bool m_link_is_uart;
    const struct device* m_flash;
    uint32_t m_last_blink{0};
};

} // namespace apx::bootloader::zephyr
```
